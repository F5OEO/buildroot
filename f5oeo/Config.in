## f5oeo/Config.in
```kconfig
#source pluto_cc.sh
menu "Applications and Tools for PlutoSDR"
	source "./f5oeo/package/lamableu-apps/Config.in"
	source "./f5oeo/package/libdvbmod/Config.in"
	source "./f5oeo/package/dvb2iq/Config.in"
    source "./f5oeo/package/libtuntap/Config.in"
    source "./f5oeo/package/pluto_dvb/Config.in"
    
endmenu
```

## f5oeo/package/pluto_dvb/Config.in
```kconfig
config BR2_PACKAGE_PLUTO_DVB
	bool "pluto_dvb"
    select BR2_PACKAGE_LIBDVBMOD
	help
	  Transport stream to DVBS/S2 modulator

	  https://github.com/F5OEO/pluto_dvb
```
